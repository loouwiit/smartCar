/**
 *
 * @cliArgs --board "/ti/boards/LP_MSPM0G3507" --product "mspm0_sdk@2.11.00.07"
 * @versions {"tool":"1.28.0+4712"}
 */

/**
 * Import the modules used in this configuration.
 */
const ADC12         = scripting.addModule("/ti/driverlib/ADC12", {}, false);
const ADC121        = ADC12.addInstance();
const CAPTURE       = scripting.addModule("/ti/driverlib/CAPTURE", {}, false);
const CAPTURE1      = CAPTURE.addInstance();
const GPIO          = scripting.addModule("/ti/driverlib/GPIO", {}, false);
const GPIO1         = GPIO.addInstance();
const GPIO2         = GPIO.addInstance();
const GPIO3         = GPIO.addInstance();
const GPIO4         = GPIO.addInstance();
const GPIO5         = GPIO.addInstance();
const GPIO6         = GPIO.addInstance();
const I2C           = scripting.addModule("/ti/driverlib/I2C", {}, false);
const I2C1          = I2C.addInstance();
const PWM           = scripting.addModule("/ti/driverlib/PWM", {}, false);
const PWM1          = PWM.addInstance();
const PWM2          = PWM.addInstance();
const SYSCTL        = scripting.addModule("/ti/driverlib/SYSCTL");
const UART          = scripting.addModule("/ti/driverlib/UART", {}, false);
const UART1         = UART.addInstance();
const ProjectConfig = scripting.addModule("/ti/project_config/ProjectConfig");

/**
 * Write custom configuration values to the imported modules.
 */
const divider7       = system.clockTree["PLL_PDIV"];
divider7.divideValue = 8;

const divider9       = system.clockTree["UDIV"];
divider9.divideValue = 2;

const multiplier2         = system.clockTree["PLL_QDIV"];
multiplier2.multiplyValue = 20;

const mux8       = system.clockTree["HSCLKMUX"];
mux8.inputSelect = "HSCLKMUX_SYSPLL2X";

ADC121.$name               = "GraySensorAdc";
ADC121.sampClkDiv          = "DL_ADC12_CLOCK_DIVIDE_4";
ADC121.powerDownMode       = "DL_ADC12_POWER_DOWN_MODE_MANUAL";
ADC121.adcMem0_name        = "Cha";
ADC121.adcMem1chansel      = "DL_ADC12_INPUT_CHAN_2";
ADC121.adcMem1_name        = "Cha";
ADC121.adcMem0chansel      = "DL_ADC12_INPUT_CHAN_2";
ADC121.sampleTime0         = "10us";
ADC121.adcPin2Config.$name = "ti_driverlib_gpio_GPIOPinGeneric8";

const Board = scripting.addModule("/ti/driverlib/Board", {}, false);

CAPTURE1.captMode                       = "EDGE_TIME_UP";
CAPTURE1.captEdgeDetection              = "FALLING";
CAPTURE1.multi_countMode                = "DL_TIMER_COUNT_MODE_UP";
CAPTURE1.multi_countRep                 = "DL_TIMER_REPEAT_MODE_ENABLED";
CAPTURE1.timerClkDiv                    = 8;
CAPTURE1.multi_cvae                     = "DL_TIMER_COUNT_AFTER_EN_ZERO";
CAPTURE1.captureInputMode               = "multi";
CAPTURE1.timerPeriod                    = "50ms";
CAPTURE1.interrupts                     = ["CC0_DN","CC0_UP","CC1_DN","CC1_UP","CC2_DN","CC2_UP","CC3_DN","CC3_UP","LOAD"];
CAPTURE1.multi_ch2_captEdgeDetection    = "DL_TIMER_CC_CCOND_TRIG_EDGE";
CAPTURE1.multi_ch3_captEdgeDetection    = "DL_TIMER_CC_CCOND_TRIG_EDGE";
CAPTURE1.timerClkPrescale               = 10;
CAPTURE1.$name                          = "EncoderCapture";
CAPTURE1.ccIndexMulti                   = [0,1];
CAPTURE1.peripheral.$assign             = "TIMA0";
CAPTURE1.peripheral.ccp0Pin.$assign     = "boosterpack.4";
CAPTURE1.peripheral.ccp1Pin.$assign     = "boosterpack.24";
CAPTURE1.ccp0PinConfig.$name            = "ti_driverlib_gpio_GPIOPinGeneric4";
CAPTURE1.ccp0PinConfig.internalResistor = "PULL_UP";
CAPTURE1.ccp1PinConfig.$name            = "ti_driverlib_gpio_GPIOPinGeneric6";

GPIO1.$name                         = "Motor";
GPIO1.associatedPins.create(4);
GPIO1.associatedPins[0].$name       = "A1";
GPIO1.associatedPins[0].pin.$assign = "boosterpack.6";
GPIO1.associatedPins[1].$name       = "A2";
GPIO1.associatedPins[1].pin.$assign = "boosterpack.26";
GPIO1.associatedPins[2].$name       = "B1";
GPIO1.associatedPins[2].pin.$assign = "boosterpack.7";
GPIO1.associatedPins[3].$name       = "B2";
GPIO1.associatedPins[3].pin.$assign = "boosterpack.27";

GPIO2.$name                              = "GraySensor";
GPIO2.associatedPins.create(3);
GPIO2.associatedPins[0].$name            = "GraySensorA";
GPIO2.associatedPins[0].internalResistor = "PULL_UP";
GPIO2.associatedPins[0].inputFilter      = "3_CYCLES";
GPIO2.associatedPins[0].pin.$assign      = "boosterpack.17";
GPIO2.associatedPins[1].$name            = "GraySensorB";
GPIO2.associatedPins[1].internalResistor = "PULL_UP";
GPIO2.associatedPins[1].inputFilter      = "3_CYCLES";
GPIO2.associatedPins[1].pin.$assign      = "boosterpack.32";
GPIO2.associatedPins[2].$name            = "GraySensorC";
GPIO2.associatedPins[2].internalResistor = "PULL_UP";
GPIO2.associatedPins[2].inputFilter      = "3_CYCLES";
GPIO2.associatedPins[2].pin.$assign      = "boosterpack.11";

GPIO3.$name                         = "EncoderGpio";
GPIO3.associatedPins.create(2);
GPIO3.associatedPins[0].$name       = "EncoderGpioA";
GPIO3.associatedPins[0].direction   = "INPUT";
GPIO3.associatedPins[0].pin.$assign = "boosterpack.23";
GPIO3.associatedPins[1].$name       = "EncoderGpioB";
GPIO3.associatedPins[1].direction   = "INPUT";
GPIO3.associatedPins[1].invert      = "ENABLE";
GPIO3.associatedPins[1].pin.$assign = "boosterpack.2";

GPIO4.$name                              = "GPIO_MPU6050";
GPIO4.associatedPins[0].$name            = "PIN_INT";
GPIO4.associatedPins[0].direction        = "INPUT";
GPIO4.associatedPins[0].internalResistor = "PULL_UP";
GPIO4.associatedPins[0].interruptEn      = true;
GPIO4.associatedPins[0].polarity         = "RISE_FALL";
GPIO4.associatedPins[0].pin.$assign      = "boosterpack.39";

GPIO5.$name                              = "KEY";
GPIO5.associatedPins[0].$name            = "KEY_1";
GPIO5.associatedPins[0].direction        = "INPUT";
GPIO5.associatedPins[0].internalResistor = "PULL_UP";
GPIO5.associatedPins[0].interruptEn      = true;
GPIO5.associatedPins[0].polarity         = "RISE_FALL";
GPIO5.associatedPins[0].inputFilter      = "3_CYCLES";
GPIO5.associatedPins[0].pin.$assign      = "j19_expansion.4";

GPIO6.$name                               = "LED";
GPIO6.associatedPins[0].launchPadShortcut = "LED2GreenEn";
GPIO6.associatedPins[0].$name             = "G";

I2C1.basicEnableController             = true;
I2C1.$name                             = "I2C_OLED";
I2C1.basicControllerStandardBusSpeed   = "Fast";
I2C1.peripheral.$assign                = "I2C1";
I2C1.peripheral.sdaPin.$assign         = "boosterpack.10";
I2C1.peripheral.sclPin.$assign         = "boosterpack.9";
I2C1.sdaPinConfig.hideOutputInversion  = scripting.forceWrite(false);
I2C1.sdaPinConfig.onlyInternalResistor = scripting.forceWrite(false);
I2C1.sdaPinConfig.passedPeripheralType = scripting.forceWrite("Digital");
I2C1.sdaPinConfig.$name                = "ti_driverlib_gpio_GPIOPinGeneric5";
I2C1.sdaPinConfig.enableConfig         = true;
I2C1.sdaPinConfig.internalResistor     = "PULL_UP";
I2C1.sclPinConfig.hideOutputInversion  = scripting.forceWrite(false);
I2C1.sclPinConfig.onlyInternalResistor = scripting.forceWrite(false);
I2C1.sclPinConfig.passedPeripheralType = scripting.forceWrite("Digital");
I2C1.sclPinConfig.$name                = "ti_driverlib_gpio_GPIOPinGeneric7";
I2C1.sclPinConfig.enableConfig         = true;
I2C1.sclPinConfig.internalResistor     = "PULL_UP";

PWM1.timerStartTimer                    = true;
PWM1.pwmMode                            = "EDGE_ALIGN_UP";
PWM1.$name                              = "Motor_Pwm";
PWM1.clockPrescale                      = 80;
PWM1.peripheral.ccp0Pin.$assign         = "boosterpack.30";
PWM1.peripheral.ccp1Pin.$assign         = "boosterpack.29";
PWM1.PWM_CHANNEL_0.$name                = "ti_driverlib_pwm_PWMTimerCC0";
PWM1.PWM_CHANNEL_1.$name                = "ti_driverlib_pwm_PWMTimerCC1";
PWM1.ccp0PinConfig.direction            = scripting.forceWrite("OUTPUT");
PWM1.ccp0PinConfig.hideOutputInversion  = scripting.forceWrite(false);
PWM1.ccp0PinConfig.onlyInternalResistor = scripting.forceWrite(false);
PWM1.ccp0PinConfig.passedPeripheralType = scripting.forceWrite("Digital");
PWM1.ccp0PinConfig.$name                = "ti_driverlib_gpio_GPIOPinGeneric2";
PWM1.ccp1PinConfig.direction            = scripting.forceWrite("OUTPUT");
PWM1.ccp1PinConfig.hideOutputInversion  = scripting.forceWrite(false);
PWM1.ccp1PinConfig.onlyInternalResistor = scripting.forceWrite(false);
PWM1.ccp1PinConfig.passedPeripheralType = scripting.forceWrite("Digital");
PWM1.ccp1PinConfig.$name                = "ti_driverlib_gpio_GPIOPinGeneric3";

PWM2.timerStartTimer                    = true;
PWM2.pwmMode                            = "EDGE_ALIGN_UP";
PWM2.$name                              = "Servomotor_Pwm";
PWM2.timerCount                         = 20000;
PWM2.ccIndex                            = [1];
PWM2.clockPrescale                      = 80;
PWM2.ccp1PinConfig.direction            = scripting.forceWrite("OUTPUT");
PWM2.ccp1PinConfig.hideOutputInversion  = scripting.forceWrite(false);
PWM2.ccp1PinConfig.onlyInternalResistor = scripting.forceWrite(false);
PWM2.ccp1PinConfig.passedPeripheralType = scripting.forceWrite("Digital");
PWM2.ccp1PinConfig.$name                = "ti_driverlib_gpio_GPIOPinGeneric9";
PWM2.peripheral.ccp1Pin.$assign         = "boosterpack.14";
PWM2.PWM_CHANNEL_1.$name                = "ti_driverlib_pwm_PWMTimerCC2";

SYSCTL.clockTreeEn = true;

UART1.$name                        = "UART_0";
UART1.enableFIFO                   = true;
UART1.enabledInterrupts            = ["DMA_DONE_RX","DMA_DONE_TX","RX_TIMEOUT_ERROR"];
UART1.enabledDMARXTriggers         = "DL_UART_DMA_INTERRUPT_RX";
UART1.enabledDMATXTriggers         = "DL_UART_DMA_INTERRUPT_TX";
UART1.rxTimeoutValue               = 1;
UART1.interruptPriority            = "1";
UART1.targetBaudRate               = 115200;
UART1.peripheral.rxPin.$assign     = "boosterpack.33";
UART1.peripheral.txPin.$assign     = "boosterpack.34";
UART1.txPinConfig.$name            = "ti_driverlib_gpio_GPIOPinGeneric0";
UART1.txPinConfig.internalResistor = "PULL_UP";
UART1.rxPinConfig.$name            = "ti_driverlib_gpio_GPIOPinGeneric1";
UART1.rxPinConfig.enableConfig     = true;
UART1.rxPinConfig.internalResistor = "PULL_UP";
UART1.DMA_CHANNEL_RX.srcLength     = "BYTE";
UART1.DMA_CHANNEL_RX.dstLength     = "BYTE";
UART1.DMA_CHANNEL_RX.addressMode   = "f2b";
UART1.DMA_CHANNEL_RX.$name         = "DMA_RX";
UART1.DMA_CHANNEL_TX.srcLength     = "BYTE";
UART1.DMA_CHANNEL_TX.dstLength     = "BYTE";
UART1.DMA_CHANNEL_TX.addressMode   = "b2f";
UART1.DMA_CHANNEL_TX.$name         = "DMA_TX";

ProjectConfig.compiler = "gcc";
ProjectConfig.genOpts  = false;
ProjectConfig.genLibs  = false;
scripting.suppress("All four File Generation options must be enabled in order to guarantee Device Migration support\\. If an option is disabled, the user must manually configure that setting on its own file\\.", ProjectConfig);

/**
 * Pinmux solution for unlocked pins/peripherals. This ensures that minor changes to the automatic solver in a future
 * version of the tool will not impact the pinmux you originally saw.  These lines can be completely deleted in order to
 * re-solve from scratch.
 */
ADC121.peripheral.$suggestSolution               = "ADC1";
ADC121.peripheral.adcPin2.$suggestSolution       = "boosterpack.28";
Board.peripheral.$suggestSolution                = "DEBUGSS";
Board.peripheral.swclkPin.$suggestSolution       = "j25_expansion.16";
Board.peripheral.swdioPin.$suggestSolution       = "j25_expansion.14";
GPIO6.associatedPins[0].pin.$suggestSolution     = "j19_expansion.10";
PWM1.peripheral.$suggestSolution                 = "TIMA1";
PWM2.peripheral.$suggestSolution                 = "TIMG6";
UART1.peripheral.$suggestSolution                = "UART0";
UART1.DMA_CHANNEL_RX.peripheral.$suggestSolution = "DMA_CH1";
UART1.DMA_CHANNEL_TX.peripheral.$suggestSolution = "DMA_CH0";
